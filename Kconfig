## Kconfig
```kconfig
menu "provisioning-manager configuration"

    config PROVISIONING_MANAGER_FIRMWARE_URL
        string "Firmware base URL"
        help
            Base URL, URL/PROVISIONING_MANAGER_FIRMWARE_CONTROL_FILE should exist
    config PROVISIONING_MANAGER_FIRMWARE_CONTROL_FILE
        string "Firmware control filename, e.g. myapp_firmware.txt"
        help
            File should be of format: number relative_filename, e.g. 1 myfirmware.bin
            
    config PROVISIONING_MANAGER_AUTOUPDATE_INTERVAL
        int "Seconds between firmware scans"
        default 30
        range 30 1440
        help
            How long to wait between firmware update checks
endmenu
```
